## boards/shields/zmk44/Kconfig.defconfig
```kconfig
if SHIELD_ZMK44_LEFT

# Name must be less than 16 characters long!
config ZMK_KEYBOARD_NAME
    default "zmk44"

config ZMK_SPLIT_ROLE_CENTRAL
    default y

endif

if SHIELD_ZMK44_LEFT || SHIELD_ZMK44_RIGHT

config ZMK_SPLIT
    default y

endif
```

## boards/shields/zmk44/Kconfig.shield
```kconfig
# No whitespace after the comma or in your part name!
config SHIELD_ZMK44_LEFT
    def_bool $(shields_list_contains,zmk44_left)

# No whitespace after the comma or in your part name!
config SHIELD_ZMK44_RIGHT
    def_bool $(shields_list_contains,zmk44_right)
```
